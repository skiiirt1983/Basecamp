## bootloader_components/main/Kconfig
```kconfig
menu "Basecamp bootloader"

    config BASECAMP_USB_RESET_IS_COLD
        bool "Treat USB-Serial-JTAG chip resets as a cold boot (return to menu)"
        default y
        help
            esptool / idf.py monitor reset the chip through the USB-Serial-JTAG
            peripheral (reset reasons USB_UART / USB_JTAG). When enabled, such
            resets discard the stored slot selection and boot the launcher, which
            is what you want after flashing. Disable if an app relies on host-
            triggered resets staying inside the app.

endmenu
```

## main/Kconfig.projbuild
```kconfig
menu "Basecamp launcher"

    config BASECAMP_SLOT0_NAME
        string "default app 1 display name"
        default "PrintSphere"
    config BASECAMP_SLOT1_NAME
        string "default app 2 display name"
        default "Capsule Radar"
    config BASECAMP_SLOT2_NAME
        string "default app 3 display name"
        default "LyricFlash"

    config BASECAMP_ENABLE_WIFI
        bool "Enable Wi-Fi, the setup network and the web page"
        default y
        help
            Turn off only for emulator runs: QEMU has no radio, so the RF calibration never
            finishes there.

    config BASECAMP_WIFI_TX_QDBM
        int "Wi-Fi transmit power (quarter dBm, 8..84)"
        range 8 84
        default 48
        help
            48 = 12 dBm. The default of the Wi-Fi driver is 20 dBm; a phone next to the
            device does not need it, and the peak current of the radio can make the
            display flash or the chip brown out on a weak supply.

    config BASECAMP_VERIFY_SLOTS
        bool "Fully verify each slot image (SHA-256) before showing it as bootable"
        default y
        help
            Adds roughly 100-200 ms per populated slot to launcher start-up.
            When disabled, only the image header and app descriptor are checked
            (the bootloader still verifies before booting).


    menu "Default apps (GitHub releases)"
        config BASECAMP_SLOT0_REPO
            string "default app 1 GitHub repo (owner/repo)"
            default "cptkirki/PrintSphere"
        config BASECAMP_SLOT0_ASSET_PREFIX
            string "default app 1 asset name starts with"
            default "printsphere_ota"
        config BASECAMP_SLOT0_ASSET_SUFFIX
            string "default app 1 asset name ends with"
            default ".bin"
        config BASECAMP_SLOT0_PROJECT
            string "default app 1 project_name must contain"
            default "printsphere"
        config BASECAMP_SLOT0_ASSET_EXCLUDE
            string "default app 1 skip assets whose name contains (comma-separated)"
            default "2.8c"
            help
                PrintSphere also publishes a build for the ESP32-S3-Touch-LCD-2.8C
                (printsphere_ota-<tag>-2.8c.bin) with the same project_name.
        config BASECAMP_SLOT0_BOARD_MARKER
            string "default app 1 image must contain (board check)"
            default "esp32_s3_touch_amoled_1_75"

        config BASECAMP_SLOT1_REPO
            string "default app 2 GitHub repo (owner/repo)"
            default "socquique/capsule-radar"
        config BASECAMP_SLOT1_ASSET_PREFIX
            string "default app 2 asset name starts with"
            default "CapsuleRadar-ota.bin"
        config BASECAMP_SLOT1_ASSET_SUFFIX
            string "default app 2 asset name ends with"
            default ".bin"
        config BASECAMP_SLOT1_PROJECT
            string "default app 2 project_name must contain"
            default "arduino-lib-builder"
            help
                Capsule Radar is an Arduino build; its descriptor is generic.
        config BASECAMP_SLOT1_ASSET_EXCLUDE
            string "default app 2 skip assets whose name contains (comma-separated)"
            default ""
        config BASECAMP_SLOT1_BOARD_MARKER
            string "default app 2 image must contain (board check)"
            default "CO5300"

        config BASECAMP_SLOT2_REPO
            string "default app 3 GitHub repo (owner/repo)"
            default "skiiirt1983/LyricFlash"
        config BASECAMP_SLOT2_ASSET_PREFIX
            string "default app 3 asset name starts with"
            default "lyricflash-ota.bin"
        config BASECAMP_SLOT2_ASSET_SUFFIX
            string "default app 3 asset name ends with"
            default ".bin"
        config BASECAMP_SLOT2_PROJECT
            string "default app 3 project_name must contain"
            default "lyricflash"
        config BASECAMP_SLOT2_ASSET_EXCLUDE
            string "default app 3 skip assets whose name contains (comma-separated)"
            default ""
        config BASECAMP_SLOT2_BOARD_MARKER
            string "default app 3 image must contain (board check)"
            default "esp32_s3_touch_amoled_1_75"
    endmenu

endmenu
```

## test_apps/qemu_selftest/sdkconfig.defaults
```kconfig
CONFIG_IDF_TARGET="esp32s3"
CONFIG_ESPTOOLPY_FLASHSIZE_16MB=y
CONFIG_PARTITION_TABLE_CUSTOM=y
CONFIG_PARTITION_TABLE_CUSTOM_FILENAME="../../partitions.csv"
CONFIG_BOOTLOADER_APP_ROLLBACK_ENABLE=n
CONFIG_ESP_CONSOLE_UART_DEFAULT=y
CONFIG_ESP_SYSTEM_PANIC_PRINT_REBOOT=y
CONFIG_ESP_TASK_WDT_INIT=n
```

## test_apps/swriter_selftest/sdkconfig.defaults
```kconfig
CONFIG_IDF_TARGET="esp32s3"
CONFIG_ESPTOOLPY_FLASHMODE_DIO=y
CONFIG_ESPTOOLPY_FLASHSIZE_16MB=y
CONFIG_PARTITION_TABLE_CUSTOM=y
CONFIG_PARTITION_TABLE_CUSTOM_FILENAME="../../partitions.csv"
CONFIG_ESP_CONSOLE_UART_DEFAULT=y
CONFIG_ESP_TASK_WDT_INIT=n
CONFIG_ESP_SYSTEM_PANIC_PRINT_REBOOT=y
CONFIG_ESP_MAIN_TASK_STACK_SIZE=8192
```
